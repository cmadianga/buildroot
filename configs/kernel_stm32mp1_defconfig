## configs/kernel_stm32mp1_defconfig
```kconfig
BR2_arm=y
BR2_cortex_a7=y
BR2_TOOLCHAIN_EXTERNAL=y
BR2_TARGET_GENERIC_ROOT_PASSWD="root"
BR2_PACKAGE_STRACE=y
BR2_PACKAGE_STRESS=y
BR2_PACKAGE_NINVADERS=y
BR2_PACKAGE_EVTEST=y
BR2_PACKAGE_DTC=y
BR2_PACKAGE_DTC_PROGRAMS=y
BR2_PACKAGE_DROPBEAR=y
```

## package/ninvaders/Config.in
```kconfig
config BR2_PACKAGE_NINVADERS
	bool "ninvaders"
	select BR2_PACKAGE_NCURSES
	help
	  A Space Invaders Clone based on ncurses.

	  http://ninvaders.sourceforge.net/
```
